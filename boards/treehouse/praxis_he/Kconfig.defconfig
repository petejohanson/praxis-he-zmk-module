## boards/treehouse/praxis_he/Kconfig.praxis_he
```kconfig
# Copyright (c) 2025 Peter Johanson
# SPDX-License-Identifier: MIT

config BOARD_PRAXIS_HE
	select SOC_STM32F411XE
	select ZMK_BOARD_COMPAT
	imply RETAINED_MEM
	imply RETENTION
	imply RETENTION_BOOT_MODE
	imply STM32_BOOTLOADER
	imply RTC
	imply BBRAM
```

## boards/treehouse/praxis_he/board.yml
```yaml
board:
  name: praxis_he
  full_name: Praxis HE
  vendor: treehouse
  socs:
    - name: stm32f411xe
```

## boards/treehouse/praxis_he/praxis_he_defconfig
```kconfig
# SPDX-License-Identifier: MIT

CONFIG_ZMK_KEYBOARD_NAME="Praxis HE"

# Enable MPU
CONFIG_ARM_MPU=y

# Enable HW stack protection
CONFIG_HW_STACK_PROTECTION=y

# Enable GPIO
CONFIG_GPIO=y

# Enable ADC needed for the matrix
CONFIG_ADC=y

# Ensure DMA for fast bulk ADC sampling
CONFIG_ADC_STM32_DMA=y

# Enable USB by default
CONFIG_ZMK_USB=y
CONFIG_USB_SELF_POWERED=n

# Settings subsystem
CONFIG_MPU_ALLOW_FLASH_WRITE=y
CONFIG_SETTINGS=y
CONFIG_FLASH=y
CONFIG_FLASH_MAP=y
CONFIG_NVS=y
CONFIG_SETTINGS_NVS=y

# ZMK Studio Overrides, prevent extra flash settings loading
CONFIG_ZMK_BEHAVIOR_LOCAL_ID_TYPE_CRC16=y

# Ensure a small enough page size that NVS is happy
CONFIG_SPI_NOR_FLASH_LAYOUT_PAGE_SIZE=4096
```
